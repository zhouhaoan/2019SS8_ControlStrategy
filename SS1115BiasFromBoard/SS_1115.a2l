/******************************************************************************
* ASAP2 file: SS_1115.a2l
* Code generation for model "SS_1115".
* Model version : 1.236
* Simulink Coder version : 8.6 (R2014a) 27-Dec-2013
* C source code generated on : Fri Nov 15 21:55:21 2019
* Target selection: ec55xx.tlc
* Embedded hardware selection: Freescale MPC5500
* Code generation objectives: Unspecified
* Validation result: Not run
* (add additional file header information here)
******************************************************************************/ ASAP2_VERSION 1 31
/* Version 1.31 */
/begin PROJECT ECUCoderProject "ECUCoder Project"
/begin HEADER "Header Comments go here" /end HEADER
/begin MODULE ModuleName "No Comment"
/begin MOD_PAR "No Comment" /end MOD_PAR
/begin MOD_COMMON "No Comment" BYTE_ORDER MSB_FIRST /end MOD_COMMON
/begin RECORD_LAYOUT Scalar_BOOLEAN FNC_VALUES 1 UBYTE COLUMN_DIR DIRECT /end RECORD_LAYOUT
/begin RECORD_LAYOUT Scalar_UBYTE FNC_VALUES 1 UBYTE COLUMN_DIR DIRECT /end RECORD_LAYOUT
/begin RECORD_LAYOUT Scalar_BYTE FNC_VALUES 1 SBYTE COLUMN_DIR DIRECT /end RECORD_LAYOUT
/begin RECORD_LAYOUT Scalar_UWORD FNC_VALUES 1 UWORD COLUMN_DIR DIRECT /end RECORD_LAYOUT
/begin RECORD_LAYOUT Scalar_SWORD FNC_VALUES 1 SWORD COLUMN_DIR DIRECT /end RECORD_LAYOUT
/begin RECORD_LAYOUT Scalar_ULONG FNC_VALUES 1 ULONG COLUMN_DIR DIRECT /end RECORD_LAYOUT
/begin RECORD_LAYOUT Scalar_LONG FNC_VALUES 1 SLONG COLUMN_DIR DIRECT /end RECORD_LAYOUT
/begin RECORD_LAYOUT Scalar_FLOAT32_IEEE FNC_VALUES 1 FLOAT32_IEEE COLUMN_DIR DIRECT /end RECORD_LAYOUT
/begin RECORD_LAYOUT Scalar_FLOAT64_IEEE FNC_VALUES 1 FLOAT64_IEEE COLUMN_DIR DIRECT /end RECORD_LAYOUT
/begin RECORD_LAYOUT Lookup1D_BYTE FNC_VALUES 1 SBYTE COLUMN_DIR DIRECT /end RECORD_LAYOUT
/begin RECORD_LAYOUT Lookup1D_X_BYTE AXIS_PTS_X 1 SBYTE INDEX_INCR DIRECT /end RECORD_LAYOUT
/begin RECORD_LAYOUT Lookup1D_UBYTE FNC_VALUES 1 UBYTE COLUMN_DIR DIRECT /end RECORD_LAYOUT
/begin RECORD_LAYOUT Lookup1D_X_UBYTE AXIS_PTS_X 1 UBYTE INDEX_INCR DIRECT /end RECORD_LAYOUT
/begin RECORD_LAYOUT Lookup1D_UWORD FNC_VALUES 1 UWORD COLUMN_DIR DIRECT /end RECORD_LAYOUT
/begin RECORD_LAYOUT Lookup1D_X_UWORD AXIS_PTS_X 1 UWORD INDEX_INCR DIRECT /end RECORD_LAYOUT
/begin RECORD_LAYOUT Lookup1D_WORD FNC_VALUES 1 SWORD COLUMN_DIR DIRECT /end RECORD_LAYOUT
/begin RECORD_LAYOUT Lookup1D_X_WORD AXIS_PTS_X 1 SWORD INDEX_INCR DIRECT /end RECORD_LAYOUT
/begin RECORD_LAYOUT Lookup1D_ULONG FNC_VALUES 1 ULONG COLUMN_DIR DIRECT /end RECORD_LAYOUT
/begin RECORD_LAYOUT Lookup1D_X_ULONG AXIS_PTS_X 1 ULONG INDEX_INCR DIRECT /end RECORD_LAYOUT
/begin RECORD_LAYOUT Lookup1D_SLONG FNC_VALUES 1 SLONG COLUMN_DIR DIRECT /end RECORD_LAYOUT
/begin RECORD_LAYOUT Lookup1D_X_LONG AXIS_PTS_X 1 SLONG INDEX_INCR DIRECT /end RECORD_LAYOUT
/begin RECORD_LAYOUT Lookup1D_FLOAT32_IEEE FNC_VALUES 1 FLOAT32_IEEE COLUMN_DIR DIRECT /end RECORD_LAYOUT
/begin RECORD_LAYOUT Lookup1D_X_FLOAT32_IEEE AXIS_PTS_X 1 FLOAT32_IEEE INDEX_INCR DIRECT /end RECORD_LAYOUT
/begin RECORD_LAYOUT Lookup1D_FLOAT64_IEEE FNC_VALUES 1 FLOAT64_IEEE COLUMN_DIR DIRECT /end RECORD_LAYOUT
/begin RECORD_LAYOUT Lookup1D_X_FLOAT64_IEEE AXIS_PTS_X 1 FLOAT64_IEEE INDEX_INCR DIRECT /end RECORD_LAYOUT
/begin RECORD_LAYOUT Lookup2D_UBYTE FNC_VALUES 1 UBYTE COLUMN_DIR DIRECT /end RECORD_LAYOUT
/begin RECORD_LAYOUT Lookup2D_X_UBYTE AXIS_PTS_X 1 UBYTE INDEX_INCR DIRECT /end RECORD_LAYOUT
/begin RECORD_LAYOUT Lookup2D_BYTE FNC_VALUES 1 SBYTE COLUMN_DIR DIRECT /end RECORD_LAYOUT
/begin RECORD_LAYOUT Lookup2D_X_BYTE AXIS_PTS_X 1 SBYTE INDEX_INCR DIRECT /end RECORD_LAYOUT
/begin RECORD_LAYOUT Lookup2D_UWORD FNC_VALUES 1 UWORD COLUMN_DIR DIRECT /end RECORD_LAYOUT
/begin RECORD_LAYOUT Lookup2D_X_UWORD AXIS_PTS_X 1 UWORD INDEX_INCR DIRECT /end RECORD_LAYOUT
/begin RECORD_LAYOUT Lookup2D_WORD FNC_VALUES 1 SWORD COLUMN_DIR DIRECT /end RECORD_LAYOUT
/begin RECORD_LAYOUT Lookup2D_X_WORD AXIS_PTS_X 1 SWORD INDEX_INCR DIRECT /end RECORD_LAYOUT
/begin RECORD_LAYOUT Lookup2D_ULONG FNC_VALUES 1 ULONG COLUMN_DIR DIRECT /end RECORD_LAYOUT
/begin RECORD_LAYOUT Lookup2D_X_ULONG AXIS_PTS_X 1 ULONG INDEX_INCR DIRECT /end RECORD_LAYOUT
/begin RECORD_LAYOUT Lookup2D_LONG FNC_VALUES 1 SLONG COLUMN_DIR DIRECT /end RECORD_LAYOUT
/begin RECORD_LAYOUT Lookup2D_X_LONG AXIS_PTS_X 1 SLONG INDEX_INCR DIRECT /end RECORD_LAYOUT
/begin RECORD_LAYOUT Lookup2D_FLOAT32_IEEE FNC_VALUES 1 FLOAT32_IEEE COLUMN_DIR DIRECT /end RECORD_LAYOUT
/begin RECORD_LAYOUT Lookup2D_X_FLOAT32_IEEE AXIS_PTS_X 1 FLOAT32_IEEE INDEX_INCR DIRECT /end RECORD_LAYOUT
/begin RECORD_LAYOUT Lookup2D_FLOAT64_IEEE FNC_VALUES 1 FLOAT64_IEEE COLUMN_DIR DIRECT /end RECORD_LAYOUT
/begin RECORD_LAYOUT Lookup2D_X_FLOAT64_IEEE AXIS_PTS_X 1 FLOAT64_IEEE INDEX_INCR DIRECT /end RECORD_LAYOUT
/begin CHARACTERISTIC APS_low_y "" CURVE 0x40001bf8 Lookup1D_FLOAT32_IEEE 0 SS_1115_CM_single -3.4E+38 3.4E+38
 /begin AXIS_DESCR COM_AXIS APS_Low SS_1115_CM_single 4 -3.4E+38 3.4E+38 AXIS_PTS_REF APS_low_x /end AXIS_DESCR
/end CHARACTERISTIC
/begin AXIS_PTS APS_low_x "" 0x40001be8 APS_Low Lookup1D_X_FLOAT32_IEEE 0 SS_1115_CM_single 4 -3.4E+38 3.4E+38 /end AXIS_PTS
/begin CHARACTERISTIC APS_High_y "" CURVE 0x40001bd8 Lookup1D_FLOAT32_IEEE 0 SS_1115_CM_single -3.4E+38 3.4E+38
 /begin AXIS_DESCR COM_AXIS APS_High SS_1115_CM_single 4 -3.4E+38 3.4E+38 AXIS_PTS_REF APS_High_x /end AXIS_DESCR
/end CHARACTERISTIC
/begin AXIS_PTS APS_High_x "" 0x40001bc8 APS_High Lookup1D_X_FLOAT32_IEEE 0 SS_1115_CM_single 4 -3.4E+38 3.4E+38 /end AXIS_PTS
/begin CHARACTERISTIC OilPressure_y "" CURVE 0x40001cf0 Lookup1D_WORD 0 SS_1115_CM_int16 -32768 32767
 /begin AXIS_DESCR COM_AXIS OilPressureIn SS_1115_CM_int16 4 -32768 32767 AXIS_PTS_REF OilPressure_x /end AXIS_DESCR
/end CHARACTERISTIC
/begin AXIS_PTS OilPressure_x "" 0x40001ce8 OilPressureIn Lookup1D_X_WORD 0 SS_1115_CM_int16 4 -32768 32767 /end AXIS_PTS
/begin CHARACTERISTIC SteerAngle_y "" CURVE 0x40001c44 Lookup1D_FLOAT32_IEEE 0 SS_1115_CM_single -3.4E+38 3.4E+38
 /begin AXIS_DESCR COM_AXIS SteerAngleInput_mea SS_1115_CM_single 15 -3.4E+38 3.4E+38 AXIS_PTS_REF SteerAngle_x /end AXIS_DESCR
/end CHARACTERISTIC
/begin AXIS_PTS SteerAngle_x "" 0x40001c08 SteerAngleInput_mea Lookup1D_X_FLOAT32_IEEE 0 SS_1115_CM_single 15 -3.4E+38 3.4E+38 /end AXIS_PTS
/begin CHARACTERISTIC SpeedLimitFactor_y "" CURVE 0x40001b88 Lookup1D_FLOAT64_IEEE 0 SS_1115_CM_double -1.7E+308 1.7E+308
 /begin AXIS_DESCR COM_AXIS NO_INPUT_QUANTITY SS_1115_CM_double 8 -1.7E+308 1.7E+308 AXIS_PTS_REF SpeedLimitFactor_x /end AXIS_DESCR
/end CHARACTERISTIC
/begin AXIS_PTS SpeedLimitFactor_x "" 0x40001b48 NO_INPUT_QUANTITY Lookup1D_X_FLOAT64_IEEE 0 SS_1115_CM_double 8 -1.7E+308 1.7E+308 /end AXIS_PTS
/begin CHARACTERISTIC Differential_cal "" VALUE 0x40001d40 Scalar_FLOAT64_IEEE 0 SS_1115_CM_double -1.7E+308 1.7E+308 /end CHARACTERISTIC
/begin CHARACTERISTIC SteerThresholdHigh_cal "" VALUE 0x40001cd0 Scalar_FLOAT64_IEEE 0 SS_1115_CM_double -1.7E+308 1.7E+308 /end CHARACTERISTIC
/begin CHARACTERISTIC SteerThresholdLow_cal "" VALUE 0x40001cd8 Scalar_FLOAT64_IEEE 0 SS_1115_CM_double -1.7E+308 1.7E+308 /end CHARACTERISTIC
/begin CHARACTERISTIC CustomReduceFactor_cal "" VALUE 0x40001ce0 Scalar_FLOAT32_IEEE 0 SS_1115_CM_single -3.4E+38 3.4E+38 /end CHARACTERISTIC
/begin CHARACTERISTIC PowerBias_cal "" VALUE 0x40001ce4 Scalar_FLOAT32_IEEE 0 SS_1115_CM_single -3.4E+38 3.4E+38 /end CHARACTERISTIC
/begin CHARACTERISTIC TorqueLimitNegativ_cal "" VALUE 0x40001cf8 Scalar_SWORD 0 SS_1115_CM_int16 -32768 32767 /end CHARACTERISTIC
/begin CHARACTERISTIC TorqueLimitPositiv_cal "" VALUE 0x40001cfa Scalar_SWORD 0 SS_1115_CM_int16 -32768 32767 /end CHARACTERISTIC
/begin CHARACTERISTIC APS_High_null "" VALUE 0x40001cfc Scalar_UWORD 0 SS_1115_CM_uint16 0 65535 /end CHARACTERISTIC
/begin CHARACTERISTIC APS_Low_null "" VALUE 0x40001cfe Scalar_UWORD 0 SS_1115_CM_uint16 0 65535 /end CHARACTERISTIC
/begin CHARACTERISTIC BrakeSignal_cal "" VALUE 0x40001d00 Scalar_UWORD 0 SS_1115_CM_uint16 0 65535 /end CHARACTERISTIC
/begin CHARACTERISTIC MotorTemperatureHigh_cal "" VALUE 0x40001d02 Scalar_UWORD 0 SS_1115_CM_uint16 0 65535 /end CHARACTERISTIC
/begin CHARACTERISTIC MotorTemperatureLow_cal "" VALUE 0x40001d04 Scalar_UWORD 0 SS_1115_CM_uint16 0 65535 /end CHARACTERISTIC
/begin CHARACTERISTIC LowSOCWarning_cal "" VALUE 0x40001d48 Scalar_UBYTE 0 SS_1115_CM_uint8 0 255 /end CHARACTERISTIC
/begin MEASUREMENT Velocity_kph "" FLOAT64_IEEE SS_1115_CM_double 0 0 -1.7E+308 1.7E+308 ECU_ADDRESS 0x40001d50 /end MEASUREMENT
/begin MEASUREMENT DifferentialLimit_mea "" FLOAT64_IEEE SS_1115_CM_double 0 0 -1.7E+308 1.7E+308 ECU_ADDRESS 0x40001da0 /end MEASUREMENT
/begin MEASUREMENT APSLow_pct "" FLOAT32_IEEE SS_1115_CM_single 0 0 -3.4E+38 3.4E+38 ECU_ADDRESS 0x40001ddc /end MEASUREMENT
/begin MEASUREMENT APSHigh_pct "" FLOAT32_IEEE SS_1115_CM_single 0 0 -3.4E+38 3.4E+38 ECU_ADDRESS 0x40001de4 /end MEASUREMENT
/begin MEASUREMENT APS_Torque "" FLOAT32_IEEE SS_1115_CM_single 0 0 -3.4E+38 3.4E+38 ECU_ADDRESS 0x40001dd0 /end MEASUREMENT
/begin MEASUREMENT AMK4_TempMotor_mea "" FLOAT32_IEEE SS_1115_CM_single 0 0 -3.4E+38 3.4E+38 ECU_ADDRESS 0x40001df8 /end MEASUREMENT
/begin MEASUREMENT AMK4_TempInverter_mea "" FLOAT32_IEEE SS_1115_CM_single 0 0 -3.4E+38 3.4E+38 ECU_ADDRESS 0x40001dfc /end MEASUREMENT
/begin MEASUREMENT AMK3_TempMotor_mea "" FLOAT32_IEEE SS_1115_CM_single 0 0 -3.4E+38 3.4E+38 ECU_ADDRESS 0x40001e08 /end MEASUREMENT
/begin MEASUREMENT AMK3_TempInverter_mea "" FLOAT32_IEEE SS_1115_CM_single 0 0 -3.4E+38 3.4E+38 ECU_ADDRESS 0x40001e0c /end MEASUREMENT
/begin MEASUREMENT AMK2_TempMotor_mea "" FLOAT32_IEEE SS_1115_CM_single 0 0 -3.4E+38 3.4E+38 ECU_ADDRESS 0x40001e18 /end MEASUREMENT
/begin MEASUREMENT AMK2_TempInverter_mea "" FLOAT32_IEEE SS_1115_CM_single 0 0 -3.4E+38 3.4E+38 ECU_ADDRESS 0x40001e1c /end MEASUREMENT
/begin MEASUREMENT AMK1_TempMotor_mea "" FLOAT32_IEEE SS_1115_CM_single 0 0 -3.4E+38 3.4E+38 ECU_ADDRESS 0x40001e28 /end MEASUREMENT
/begin MEASUREMENT AMK1_TempInverter_mea "" FLOAT32_IEEE SS_1115_CM_single 0 0 -3.4E+38 3.4E+38 ECU_ADDRESS 0x40001e2c /end MEASUREMENT
/begin MEASUREMENT SOCReduceFactor_mea "" FLOAT32_IEEE SS_1115_CM_single 0 0 -3.4E+38 3.4E+38 ECU_ADDRESS 0x40001d7c /end MEASUREMENT
/begin MEASUREMENT APPSFaultCheck_mea "" FLOAT32_IEEE SS_1115_CM_single 0 0 -3.4E+38 3.4E+38 ECU_ADDRESS 0x40001df0 /end MEASUREMENT
/begin MEASUREMENT CustomReduceFactor1_mea "" FLOAT32_IEEE SS_1115_CM_single 0 0 -3.4E+38 3.4E+38 ECU_ADDRESS 0x40001dbc /end MEASUREMENT
/begin MEASUREMENT TqLimitFactor_mea "" FLOAT32_IEEE SS_1115_CM_single 0 0 -3.4E+38 3.4E+38 ECU_ADDRESS 0x40001d58 /end MEASUREMENT
/begin MEASUREMENT Powersum_mea "" FLOAT32_IEEE SS_1115_CM_single 0 0 -3.4E+38 3.4E+38 ECU_ADDRESS 0x40001d88 /end MEASUREMENT
/begin MEASUREMENT FrontPowerBias_mea "" FLOAT32_IEEE SS_1115_CM_single 0 0 -3.4E+38 3.4E+38 ECU_ADDRESS 0x40001d94 /end MEASUREMENT
/begin MEASUREMENT RearPowerBias_mea "" FLOAT32_IEEE SS_1115_CM_single 0 0 -3.4E+38 3.4E+38 ECU_ADDRESS 0x40001d80 /end MEASUREMENT
/begin MEASUREMENT DiffFactorRT_mea "" FLOAT32_IEEE SS_1115_CM_single 0 0 -3.4E+38 3.4E+38 ECU_ADDRESS 0x40001da8 /end MEASUREMENT
/begin MEASUREMENT PowerReduceFactor_mea "" FLOAT32_IEEE SS_1115_CM_single 0 0 -3.4E+38 3.4E+38 ECU_ADDRESS 0x40001d8c /end MEASUREMENT
/begin MEASUREMENT SlipRatio_mea "" FLOAT32_IEEE SS_1115_CM_single 0 0 -3.4E+38 3.4E+38 ECU_ADDRESS 0x40001d78 /end MEASUREMENT
/begin MEASUREMENT APPS_BrakeRuleCheck_mea "" FLOAT32_IEEE SS_1115_CM_single 0 0 -3.4E+38 3.4E+38 ECU_ADDRESS 0x40001dec /end MEASUREMENT
/begin MEASUREMENT SteerAngleInDegree_mea "" SWORD SS_1115_CM_int16 0 0 -32768 32767 ECU_ADDRESS 0x40001d72 /end MEASUREMENT
/begin MEASUREMENT Tq1_mea "" SWORD SS_1115_CM_int16 0 0 -32768 32767 ECU_ADDRESS 0x40001d62 /end MEASUREMENT
/begin MEASUREMENT Tq2_mea "" SWORD SS_1115_CM_int16 0 0 -32768 32767 ECU_ADDRESS 0x40001d60 /end MEASUREMENT
/begin MEASUREMENT Tq3_mea "" SWORD SS_1115_CM_int16 0 0 -32768 32767 ECU_ADDRESS 0x40001d5e /end MEASUREMENT
/begin MEASUREMENT Tq4_mea "" SWORD SS_1115_CM_int16 0 0 -32768 32767 ECU_ADDRESS 0x40001d5c /end MEASUREMENT
/begin MEASUREMENT AngleThresholdLow_mea "" SWORD SS_1115_CM_int16 0 0 -32768 32767 ECU_ADDRESS 0x40001dcc /end MEASUREMENT
/begin MEASUREMENT AngleThresholdHigh_mea "" SWORD SS_1115_CM_int16 0 0 -32768 32767 ECU_ADDRESS 0x40001dce /end MEASUREMENT
/begin MEASUREMENT TorqueLimitPositiv_mea "" SWORD SS_1115_CM_int16 0 0 -32768 32767 ECU_ADDRESS 0x40001d64 /end MEASUREMENT
/begin MEASUREMENT TorqueLimitNegativ_mea "" SWORD SS_1115_CM_int16 0 0 -32768 32767 ECU_ADDRESS 0x40001d66 /end MEASUREMENT
/begin MEASUREMENT APS_Low "" UWORD SS_1115_CM_uint16 0 0 0 65535 ECU_ADDRESS 0x40001dd4 /end MEASUREMENT
/begin MEASUREMENT APS_High "" UWORD SS_1115_CM_uint16 0 0 0 65535 ECU_ADDRESS 0x40001dd6 /end MEASUREMENT
/begin MEASUREMENT OilPressureIn "" UWORD SS_1115_CM_uint16 0 0 0 65535 ECU_ADDRESS 0x40001d90 /end MEASUREMENT
/begin MEASUREMENT Suspension_FL_mea "" UWORD SS_1115_CM_uint16 0 0 0 65535 ECU_ADDRESS 0x40001d6e /end MEASUREMENT
/begin MEASUREMENT Suspension_FR_mea "" UWORD SS_1115_CM_uint16 0 0 0 65535 ECU_ADDRESS 0x40001d6c /end MEASUREMENT
/begin MEASUREMENT Suspension_RL_mea "" UWORD SS_1115_CM_uint16 0 0 0 65535 ECU_ADDRESS 0x40001d6a /end MEASUREMENT
/begin MEASUREMENT Suspension_RR_mea "" UWORD SS_1115_CM_uint16 0 0 0 65535 ECU_ADDRESS 0x40001d68 /end MEASUREMENT
/begin MEASUREMENT SteerAngleInput_mea "" UWORD SS_1115_CM_uint16 0 0 0 65535 ECU_ADDRESS 0x40001d70 /end MEASUREMENT
/begin MEASUREMENT AMK4_ActualVelocity_mea "" UWORD SS_1115_CM_uint16 0 0 0 65535 ECU_ADDRESS 0x40001e00 /end MEASUREMENT
/begin MEASUREMENT AMK3_ActualVelocity_mea "" UWORD SS_1115_CM_uint16 0 0 0 65535 ECU_ADDRESS 0x40001e10 /end MEASUREMENT
/begin MEASUREMENT AMK2_ActualVelocity_mea "" UWORD SS_1115_CM_uint16 0 0 0 65535 ECU_ADDRESS 0x40001e20 /end MEASUREMENT
/begin MEASUREMENT AMK1_ActualVelocity_mea "" UWORD SS_1115_CM_uint16 0 0 0 65535 ECU_ADDRESS 0x40001e30 /end MEASUREMENT
/begin MEASUREMENT APSLOK_mea "" UBYTE SS_1115_CM_uint8 0 0 0 255 ECU_ADDRESS 0x40001de0 /end MEASUREMENT
/begin MEASUREMENT APSROK_mea "" UBYTE SS_1115_CM_uint8 0 0 0 255 ECU_ADDRESS 0x40001dd8 /end MEASUREMENT
/begin MEASUREMENT Pressure "" UBYTE SS_1115_CM_uint8 0 0 0 255 ECU_ADDRESS 0x40001d84 /end MEASUREMENT
/begin MEASUREMENT AMK4_bSystemReady_mea "" UBYTE SS_1115_CM_uint8 0 0 0 255 ECU_ADDRESS 0x40001df4 /end MEASUREMENT
/begin MEASUREMENT AMK4_bQuitDcOn_mea "" UBYTE SS_1115_CM_uint8 0 0 0 255 ECU_ADDRESS 0x40001df6 /end MEASUREMENT
/begin MEASUREMENT AMK4_bError_mea "" UBYTE SS_1115_CM_uint8 0 0 0 255 ECU_ADDRESS 0x40001df7 /end MEASUREMENT
/begin MEASUREMENT AMK4_bQuitInverterOn_mea "" UBYTE SS_1115_CM_uint8 0 0 0 255 ECU_ADDRESS 0x40001df5 /end MEASUREMENT
/begin MEASUREMENT AMK3_bSystemReady_mea "" UBYTE SS_1115_CM_uint8 0 0 0 255 ECU_ADDRESS 0x40001e02 /end MEASUREMENT
/begin MEASUREMENT AMK3_bQuitDcOn_mea "" UBYTE SS_1115_CM_uint8 0 0 0 255 ECU_ADDRESS 0x40001e04 /end MEASUREMENT
/begin MEASUREMENT AMK3_bError_mea "" UBYTE SS_1115_CM_uint8 0 0 0 255 ECU_ADDRESS 0x40001e05 /end MEASUREMENT
/begin MEASUREMENT AMK3_bQuitInverterOn_mea "" UBYTE SS_1115_CM_uint8 0 0 0 255 ECU_ADDRESS 0x40001e03 /end MEASUREMENT
/begin MEASUREMENT AMK2_bSystemReady_mea "" UBYTE SS_1115_CM_uint8 0 0 0 255 ECU_ADDRESS 0x40001e12 /end MEASUREMENT
/begin MEASUREMENT AMK2_bQuitDcOn_mea "" UBYTE SS_1115_CM_uint8 0 0 0 255 ECU_ADDRESS 0x40001e14 /end MEASUREMENT
/begin MEASUREMENT AMK2_bError_mea "" UBYTE SS_1115_CM_uint8 0 0 0 255 ECU_ADDRESS 0x40001e15 /end MEASUREMENT
/begin MEASUREMENT AMK2_bQuitInverterOn_mea "" UBYTE SS_1115_CM_uint8 0 0 0 255 ECU_ADDRESS 0x40001e13 /end MEASUREMENT
/begin MEASUREMENT AMK1_bSystemReady_mea "" UBYTE SS_1115_CM_uint8 0 0 0 255 ECU_ADDRESS 0x40001e22 /end MEASUREMENT
/begin MEASUREMENT AMK1_bQuitDcOn_mea "" UBYTE SS_1115_CM_uint8 0 0 0 255 ECU_ADDRESS 0x40001e24 /end MEASUREMENT
/begin MEASUREMENT AMK1_bError_mea "" UBYTE SS_1115_CM_uint8 0 0 0 255 ECU_ADDRESS 0x40001e25 /end MEASUREMENT
/begin MEASUREMENT AMK1_bQuitInverterOn_mea "" UBYTE SS_1115_CM_uint8 0 0 0 255 ECU_ADDRESS 0x40001e23 /end MEASUREMENT
/begin MEASUREMENT DRSCANOK_mea "" UBYTE SS_1115_CM_uint8 0 0 0 255 ECU_ADDRESS 0x40001db8 /end MEASUREMENT
/begin MEASUREMENT DRSCAN_MEA "" UBYTE SS_1115_CM_uint8 0 0 0 255 /* Array Size */ ARRAY_SIZE 8 ECU_ADDRESS 0x40001db0 /end MEASUREMENT
/begin MEASUREMENT BMSCANOK_mea "" UBYTE SS_1115_CM_uint8 0 0 0 255 ECU_ADDRESS 0x40001dca /end MEASUREMENT
/begin MEASUREMENT CAN0512OK_mea "" UBYTE SS_1115_CM_uint8 0 0 0 255 ECU_ADDRESS 0x40001dc6 /end MEASUREMENT
/begin MEASUREMENT CAN0518OK_mea "" UBYTE SS_1115_CM_uint8 0 0 0 255 ECU_ADDRESS 0x40001dc5 /end MEASUREMENT
/begin MEASUREMENT CAN1OK_mea "" UBYTE SS_1115_CM_uint8 0 0 0 255 ECU_ADDRESS 0x40001dc3 /end MEASUREMENT
/begin MEASUREMENT CAN2OK_mea "" UBYTE SS_1115_CM_uint8 0 0 0 255 ECU_ADDRESS 0x40001dc2 /end MEASUREMENT
/begin MEASUREMENT CAN3OK_mea "" UBYTE SS_1115_CM_uint8 0 0 0 255 ECU_ADDRESS 0x40001dc1 /end MEASUREMENT
/begin MEASUREMENT CAN4OK_mea "" UBYTE SS_1115_CM_uint8 0 0 0 255 ECU_ADDRESS 0x40001dc0 /end MEASUREMENT
/begin MEASUREMENT CAN0334OK_mea "" UBYTE SS_1115_CM_uint8 0 0 0 255 ECU_ADDRESS 0x40001dc7 /end MEASUREMENT
/begin MEASUREMENT DRSState_mea "" UBYTE SS_1115_CM_uint8 0 0 0 255 ECU_ADDRESS 0x40001dac /end MEASUREMENT
/begin MEASUREMENT ECU_InverterOn "" UBYTE SS_1115_CM_uint8 0 0 0 255 ECU_ADDRESS 0x40001d99 /end MEASUREMENT
/begin MEASUREMENT ECU_DcOn "" UBYTE SS_1115_CM_uint8 0 0 0 255 ECU_ADDRESS 0x40001d9c /end MEASUREMENT
/begin MEASUREMENT ECU_Enable "" UBYTE SS_1115_CM_uint8 0 0 0 255 ECU_ADDRESS 0x40001d9b /end MEASUREMENT
/begin MEASUREMENT ECU_ErrorReset "" UBYTE SS_1115_CM_uint8 0 0 0 255 ECU_ADDRESS 0x40001d9a /end MEASUREMENT
/begin MEASUREMENT CAN0522OK_mea "" UBYTE SS_1115_CM_uint8 0 0 0 255 ECU_ADDRESS 0x40001dc4 /end MEASUREMENT
/begin MEASUREMENT StartSignal "" UBYTE SS_1115_CM_boolean 0 0 0 1 ECU_ADDRESS 0x40001d74 /end MEASUREMENT
/begin MEASUREMENT APSBothOK_mea "" UBYTE SS_1115_CM_boolean 0 0 0 1 ECU_ADDRESS 0x40001de8 /end MEASUREMENT
/begin MEASUREMENT BrakeSignal_mea "" UBYTE SS_1115_CM_boolean 0 0 0 1 ECU_ADDRESS 0x40001dc9 /end MEASUREMENT
/begin MEASUREMENT FanOpenSignal_mea "" UBYTE SS_1115_CM_boolean 0 0 0 1 ECU_ADDRESS 0x40001d98 /end MEASUREMENT
/begin MEASUREMENT Buzzing_mea "" UBYTE SS_1115_CM_boolean 0 0 0 1 ECU_ADDRESS 0x40001dc8 /end MEASUREMENT
/begin MEASUREMENT LowSOCWarning_mea "" UBYTE SS_1115_CM_boolean 0 0 0 1 ECU_ADDRESS 0x40001d92 /end MEASUREMENT
/begin COMPU_METHOD SS_1115_CM_single "Q = V" RAT_FUNC "%8.6" "" COEFFS 0 1 0 0 0 1 /end COMPU_METHOD
/begin COMPU_METHOD SS_1115_CM_int16 "Q = V" RAT_FUNC "%5.0" "" COEFFS 0 1 0 0 0 1 /end COMPU_METHOD
/begin COMPU_METHOD SS_1115_CM_double "Q = V" RAT_FUNC "%15.10" "" COEFFS 0 1 0 0 0 1 /end COMPU_METHOD
/begin COMPU_METHOD SS_1115_CM_uint16 "Q = V" RAT_FUNC "%5.0" "" COEFFS 0 1 0 0 0 1 /end COMPU_METHOD
/begin COMPU_METHOD SS_1115_CM_uint8 "Q = V" RAT_FUNC "%3.0" "" COEFFS 0 1 0 0 0 1 /end COMPU_METHOD
/begin COMPU_METHOD SS_1115_CM_boolean "Q = V" RAT_FUNC "%1.0" "" COEFFS 0 1 0 0 0 1 /end COMPU_METHOD
/begin GROUP SS_1115 "SS_1115" /* Root */ ROOT
 /begin SUB_GROUP Root_Function_Call_Subsystem Root_HardWare_Input Root_VCU_MCU /end SUB_GROUP
/end GROUP
/begin GROUP Root_Function_Call_Subsystem "SS_1115/Function-Call Subsystem" /begin REF_MEASUREMENT CAN0512OK_mea Velocity_kph /end REF_MEASUREMENT /end GROUP
/begin GROUP Root_HardWare_Input "SS_1115/HardWare_Input"
 /begin SUB_GROUP S2_APSProcess S2_BMS_Info S2_DRS_CMDInput S2_In1_Message S2_In2_Message S2_In3_Message S2_In4_Message S2_OilPressrue_Mpa S2_Steer_Angle /end SUB_GROUP
 /begin REF_MEASUREMENT OilPressureIn StartSignal Suspension_FL_mea Suspension_FR_mea Suspension_RL_mea Suspension_RR_mea /end REF_MEASUREMENT
/end GROUP
/begin GROUP Root_VCU_MCU "SS_1115/VCU_MCU" /begin SUB_GROUP S4_Atomic_Subsystem S4_Enabled_Subsystem /end SUB_GROUP /begin REF_MEASUREMENT FanOpenSignal_mea /end REF_MEASUREMENT /end GROUP
/begin GROUP S2_APSProcess "SS_1115/HardWare_Input/APSProcess"
 /begin REF_MEASUREMENT APSBothOK_mea APSHigh_pct APSLOK_mea APSLow_pct APSROK_mea APS_High APS_Low APS_Torque /end REF_MEASUREMENT
/end GROUP
/begin GROUP S2_BMS_Info "SS_1115/HardWare_Input/BMS Info" /begin REF_MEASUREMENT BMSCANOK_mea /end REF_MEASUREMENT /end GROUP
/begin GROUP S2_DRS_CMDInput "SS_1115/HardWare_Input/DRS CMDInput" /begin REF_MEASUREMENT DRSCANOK_mea DRSCAN_MEA /end REF_MEASUREMENT /end GROUP
/begin GROUP S2_In1_Message "SS_1115/HardWare_Input/In1_Message" /begin SUB_GROUP S8_Function_Call_Subsystem S8_Function_Call_Subsystem1 /end SUB_GROUP /end GROUP
/begin GROUP S2_In2_Message "SS_1115/HardWare_Input/In2_Message" /begin SUB_GROUP S9_Function_Call_Subsystem S9_Function_Call_Subsystem1 /end SUB_GROUP /end GROUP
/begin GROUP S2_In3_Message "SS_1115/HardWare_Input/In3_Message" /begin SUB_GROUP S10_Function_Call_Subsystem S10_Function_Call_Subsystem1 /end SUB_GROUP /end GROUP
/begin GROUP S2_In4_Message "SS_1115/HardWare_Input/In4_Message" /begin SUB_GROUP S11_Function_Call_Subsystem S11_Function_Call_Subsystem1 /end SUB_GROUP /end GROUP
/begin GROUP S2_OilPressrue_Mpa "SS_1115/HardWare_Input/OilPressrue_Mpa" /begin REF_MEASUREMENT BrakeSignal_mea Pressure /end REF_MEASUREMENT /end GROUP
/begin GROUP S2_Steer_Angle "SS_1115/HardWare_Input/Steer Angle" /begin REF_MEASUREMENT SteerAngleInDegree_mea SteerAngleInput_mea /end REF_MEASUREMENT /end GROUP
/begin GROUP S4_Atomic_Subsystem "SS_1115/VCU_MCU/Atomic Subsystem" /begin REF_MEASUREMENT CAN0522OK_mea /end REF_MEASUREMENT /end GROUP
/begin GROUP S4_Enabled_Subsystem "SS_1115/VCU_MCU/Enabled Subsystem" /begin SUB_GROUP S63_SlipRatio_Cal S63_Torquearrengement /end SUB_GROUP
 /begin REF_MEASUREMENT APPSFaultCheck_mea APPS_BrakeRuleCheck_mea Buzzing_mea CAN0334OK_mea CAN0518OK_mea CAN1OK_mea CAN2OK_mea CAN3OK_mea CAN4OK_mea CustomReduceFactor1_mea DRSState_mea ECU_DcOn ECU_Enable ECU_ErrorReset ECU_InverterOn LowSOCWarning_mea SOCReduceFactor_mea TorqueLimitNegativ_mea TorqueLimitPositiv_mea Tq1_mea Tq2_mea Tq3_mea Tq4_mea /end REF_MEASUREMENT
/end GROUP
/begin GROUP S8_Function_Call_Subsystem "SS_1115/HardWare_Input/In1_Message/Function-Call Subsystem" /begin SUB_GROUP S19_Subsystem1 /end SUB_GROUP /end GROUP
/begin GROUP S8_Function_Call_Subsystem1 "SS_1115/HardWare_Input/In1_Message/Function-Call Subsystem1" /begin SUB_GROUP S20_Subsystem /end SUB_GROUP /end GROUP
/begin GROUP S9_Function_Call_Subsystem "SS_1115/HardWare_Input/In2_Message/Function-Call Subsystem" /begin SUB_GROUP S24_Subsystem1 /end SUB_GROUP /end GROUP
/begin GROUP S9_Function_Call_Subsystem1 "SS_1115/HardWare_Input/In2_Message/Function-Call Subsystem1" /begin SUB_GROUP S25_Subsystem /end SUB_GROUP /end GROUP
/begin GROUP S10_Function_Call_Subsystem "SS_1115/HardWare_Input/In3_Message/Function-Call Subsystem" /begin SUB_GROUP S29_Subsystem1 /end SUB_GROUP /end GROUP
/begin GROUP S10_Function_Call_Subsystem1 "SS_1115/HardWare_Input/In3_Message/Function-Call Subsystem1" /begin SUB_GROUP S30_Subsystem /end SUB_GROUP /end GROUP
/begin GROUP S11_Function_Call_Subsystem "SS_1115/HardWare_Input/In4_Message/Function-Call Subsystem" /begin SUB_GROUP S34_Subsystem1 /end SUB_GROUP /end GROUP
/begin GROUP S11_Function_Call_Subsystem1 "SS_1115/HardWare_Input/In4_Message/Function-Call Subsystem1" /begin SUB_GROUP S35_Subsystem /end SUB_GROUP /end GROUP
/begin GROUP S63_SlipRatio_Cal "SS_1115/VCU_MCU/Enabled Subsystem/SlipRatio_Cal" /begin REF_MEASUREMENT SlipRatio_mea /end REF_MEASUREMENT /end GROUP
/begin GROUP S63_Torquearrengement "SS_1115/VCU_MCU/Enabled Subsystem/Torquearrengement" /begin SUB_GROUP S75_Differential_ S75_PowerBias_ /end SUB_GROUP /begin REF_MEASUREMENT PowerReduceFactor_mea Powersum_mea TqLimitFactor_mea /end REF_MEASUREMENT /end GROUP
/begin GROUP S19_Subsystem1 "SS_1115/HardWare_Input/In1_Message/Function-Call Subsystem/Subsystem1" /begin SUB_GROUP S21_Subsystem /end SUB_GROUP /begin REF_MEASUREMENT AMK1_ActualVelocity_mea /end REF_MEASUREMENT /end GROUP
/begin GROUP S20_Subsystem "SS_1115/HardWare_Input/In1_Message/Function-Call Subsystem1/Subsystem" /begin REF_MEASUREMENT AMK1_TempInverter_mea AMK1_TempMotor_mea /end REF_MEASUREMENT /end GROUP
/begin GROUP S24_Subsystem1 "SS_1115/HardWare_Input/In2_Message/Function-Call Subsystem/Subsystem1" /begin SUB_GROUP S26_Subsystem /end SUB_GROUP /begin REF_MEASUREMENT AMK2_ActualVelocity_mea /end REF_MEASUREMENT /end GROUP
/begin GROUP S25_Subsystem "SS_1115/HardWare_Input/In2_Message/Function-Call Subsystem1/Subsystem" /begin REF_MEASUREMENT AMK2_TempInverter_mea AMK2_TempMotor_mea /end REF_MEASUREMENT /end GROUP
/begin GROUP S29_Subsystem1 "SS_1115/HardWare_Input/In3_Message/Function-Call Subsystem/Subsystem1" /begin SUB_GROUP S31_Subsystem /end SUB_GROUP /begin REF_MEASUREMENT AMK3_ActualVelocity_mea /end REF_MEASUREMENT /end GROUP
/begin GROUP S30_Subsystem "SS_1115/HardWare_Input/In3_Message/Function-Call Subsystem1/Subsystem" /begin REF_MEASUREMENT AMK3_TempInverter_mea AMK3_TempMotor_mea /end REF_MEASUREMENT /end GROUP
/begin GROUP S34_Subsystem1 "SS_1115/HardWare_Input/In4_Message/Function-Call Subsystem/Subsystem1" /begin SUB_GROUP S36_Subsystem /end SUB_GROUP /begin REF_MEASUREMENT AMK4_ActualVelocity_mea /end REF_MEASUREMENT /end GROUP
/begin GROUP S35_Subsystem "SS_1115/HardWare_Input/In4_Message/Function-Call Subsystem1/Subsystem" /begin REF_MEASUREMENT AMK4_TempInverter_mea AMK4_TempMotor_mea /end REF_MEASUREMENT /end GROUP
/begin GROUP S75_Differential_ "SS_1115/VCU_MCU/Enabled Subsystem/Torquearrengement/Differential_" /begin SUB_GROUP S86_Watchup_Table /end SUB_GROUP
 /begin REF_MEASUREMENT AngleThresholdHigh_mea AngleThresholdLow_mea DifferentialLimit_mea /end REF_MEASUREMENT
/end GROUP
/begin GROUP S75_PowerBias_ "SS_1115/VCU_MCU/Enabled Subsystem/Torquearrengement/PowerBias_" /begin REF_MEASUREMENT FrontPowerBias_mea RearPowerBias_mea /end REF_MEASUREMENT /end GROUP
/begin GROUP S21_Subsystem "SS_1115/HardWare_Input/In1_Message/Function-Call Subsystem/Subsystem1/Subsystem"
 /begin REF_MEASUREMENT AMK1_bError_mea AMK1_bQuitDcOn_mea AMK1_bQuitInverterOn_mea AMK1_bSystemReady_mea /end REF_MEASUREMENT
/end GROUP
/begin GROUP S26_Subsystem "SS_1115/HardWare_Input/In2_Message/Function-Call Subsystem/Subsystem1/Subsystem"
 /begin REF_MEASUREMENT AMK2_bError_mea AMK2_bQuitDcOn_mea AMK2_bQuitInverterOn_mea AMK2_bSystemReady_mea /end REF_MEASUREMENT
/end GROUP
/begin GROUP S31_Subsystem "SS_1115/HardWare_Input/In3_Message/Function-Call Subsystem/Subsystem1/Subsystem"
 /begin REF_MEASUREMENT AMK3_bError_mea AMK3_bQuitDcOn_mea AMK3_bQuitInverterOn_mea AMK3_bSystemReady_mea /end REF_MEASUREMENT
/end GROUP
/begin GROUP S36_Subsystem "SS_1115/HardWare_Input/In4_Message/Function-Call Subsystem/Subsystem1/Subsystem"
 /begin REF_MEASUREMENT AMK4_bError_mea AMK4_bQuitDcOn_mea AMK4_bQuitInverterOn_mea AMK4_bSystemReady_mea /end REF_MEASUREMENT
/end GROUP
/begin GROUP S86_Watchup_Table "SS_1115/VCU_MCU/Enabled Subsystem/Torquearrengement/Differential_/Watchup-Table" /begin REF_MEASUREMENT DiffFactorRT_mea /end REF_MEASUREMENT /end GROUP
/end MODULE
/end PROJECT
/* (add any file trailer comments here) */
/* EOF SS_1115.a2l */
